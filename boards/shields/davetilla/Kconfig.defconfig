## boards/shields/davetilla/Kconfig.defconfig
```kconfig
if SHIELD_DAVETILLA_DONGLE || SHIELD_DAVETILLA_LEFT_CENTRAL

config ZMK_SPLIT
    default y

config ZMK_SPLIT_ROLE_CENTRAL
    default y

config ZMK_USB
    default y

config ZMK_SPLIT_BLE_CENTRAL_BATTERY_LEVEL_FETCHING
    default y

endif

if SHIELD_DAVETILLA_DONGLE

config ZMK_KEYBOARD_NAME
    default "Dongletilla"

config ZMK_SPLIT_BLE_CENTRAL_PERIPHERALS
    default 2

config BT_MAX_CONN
    default 7

config BT_MAX_PAIRED
    default 7

config ZMK_DISPLAY
    default n

config ZMK_IDLE_TIMEOUT
    default 300000

config BT_BAS
    default n

endif

if SHIELD_DAVETILLA_LEFT_CENTRAL

config ZMK_KEYBOARD_NAME
    default "Davetilla"

config ZMK_SPLIT_BLE_CENTRAL_PERIPHERALS
    default 1

config BT_MAX_CONN
    default 6

config BT_MAX_PAIRED
    default 6

config ZMK_SPLIT_BLE_CENTRAL_BATTERY_LEVEL_PROXY
    default y

endif

if SHIELD_DAVETILLA_LEFT_PERIPHERAL || SHIELD_DAVETILLA_RIGHT_PERIPHERAL

config ZMK_SPLIT
    default y

endif

if SHIELD_DAVETILLA_MACRO_RIGHT

config ZMK_KEYBOARD_NAME
    default "Davetilla Macro"

config ZMK_USB
    default y

config BT_MAX_CONN
    default 5

config BT_MAX_PAIRED
    default 5

endif

config ZMK_BLE
    default y
```

## boards/shields/davetilla/Kconfig.shield
```kconfig
config SHIELD_DAVETILLA_LEFT_CENTRAL
    def_bool $(shields_list_contains,davetilla_left_central)

config SHIELD_DAVETILLA_RIGHT_PERIPHERAL
    def_bool $(shields_list_contains,davetilla_right_peripheral)

config SHIELD_DAVETILLA_DONGLE
    def_bool $(shields_list_contains,davetilla_dongle)

config SHIELD_DAVETILLA_LEFT_PERIPHERAL
    def_bool $(shields_list_contains,davetilla_left_peripheral)

config SHIELD_DAVETILLA_MACRO_RIGHT
    def_bool $(shields_list_contains,davetilla_macro_right)
```

## config/west.yml
```yaml
manifest:
  remotes:
    - name: zmkfirmware
      url-base: https://github.com/zmkfirmware
    - name: caksoylar
      url-base: https://github.com/caksoylar
    - name: otherdave
      url-base: https://github.com/otherdave
  projects:
    - name: zmk
      remote: zmkfirmware
      revision: main
      import: app/west.yml
    - name: zmk-rgbled-widget
      remote: caksoylar
      revision: main
#    - name: zmk-led-matrix
#      remote: otherdave
#      revision: main
  self:
    path: config
```
